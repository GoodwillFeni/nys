## nys_esp/sdkconfig.defaults.esp32
```kconfig
CONFIG_BLINK_GPIO=5

# ── BLE (NimBLE) ────────────────────────────────────────────────────────────
CONFIG_BT_ENABLED=y
CONFIG_BT_NIMBLE_ENABLED=y
CONFIG_BT_CONTROLLER_ENABLED=y
CONFIG_BTDM_CTRL_MODE_BLE_ONLY=y
CONFIG_BTDM_CTRL_MODE_BR_EDR_ONLY=n
CONFIG_BTDM_CTRL_MODE_BTDM=n

# WiFi + BLE coexistence (required for both to run simultaneously)
CONFIG_SW_COEXIST_ENABLE=y
```

## nys_esp/sdkconfig.defaults.esp32c3
```kconfig
CONFIG_BLINK_LED_STRIP=y

# ── BLE (NimBLE) — ESP32-C3 is BLE-only ─────────────────────────────────────
CONFIG_BT_ENABLED=y
CONFIG_BT_NIMBLE_ENABLED=y
CONFIG_BT_CONTROLLER_ENABLED=y

# WiFi + BLE coexistence
CONFIG_SW_COEXIST_ENABLE=y
```
